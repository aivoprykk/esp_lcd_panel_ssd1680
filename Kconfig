## Kconfig
```kconfig
menu "SSD168X EPD Module Options"
    config DISPLAY_DRIVER_SSD168X
        bool "Enable SSD168X Module"
        default y if HAS_BOARD_LILYGO_EPAPER_T5
        default n
        help
            Selected when SSD168X driver present
    config LCD_IS_EPD
        bool
        default y if DISPLAY_DRIVER_SSD168X
        default n
        help
            This is an EPD (E-Ink) display. Enable this option if you are using an EPD display based on SSD1680 or SSD1681 controller.
            Note: Enabling this option will disable some features like partial update, high refresh rate, and color depth > 1bpp.
            These features are not supported by EPD displays.
    if LCD_IS_EPD
    choice SSD168X_PANEL
        prompt "Installed Panel"
        default SSD168X_PANEL_SSD1680
        config SSD168X_PANEL_SSD1680
            bool "SSD1680"
        config SSD168X_PANEL_SSD1681
            bool "SSD1681"
    endchoice
    choice SSD168X_SCREEN
        prompt "Screen model"
        default SSD168X_SCREEN_DEPG0213BN if SSD168X_PANEL_SSD1680
        default SSD168X_SCREEN_GDEY0154D67 if SSD168X_PANEL_SSD1681
        config SSD168X_SCREEN_DEPG0213BN
            depends on SSD168X_PANEL_SSD1680
            bool "DEPG0213BN 2.13 122x250 Eink"
            help
                Select if screen model is DEPG0213BN
        config SSD168X_SCREEN_GDEY0213B74
            depends on SSD168X_PANEL_SSD1680
            bool "GDEY0213B74 2.13 122x250 Eink"
            help 
                Select if screen model is GDEY0213B74
    
        config SSD168X_SCREEN_GDEY0154D67
            depends on SSD168X_PANEL_SSD1681
            bool "GDEY0154D67 1.54 200x200 Eink"
            help 
                Select if screen model is GDEY0154D67
    
    endchoice
    endif
endmenu
```
